## conf/bblayers.conf
```bitbake
LCONF_VERSION = "7"

BBPATH = "${TOPDIR}"
BSPDIR := "${@os.path.abspath(os.path.dirname(d.getVar('FILE', True)) + '/../..')}"

BBFILES ?= ""
BBLAYERS = " \
  ${BSPDIR}/poky/meta \
  ${BSPDIR}/poky/meta-poky \
  \
  ${BSPDIR}/meta-openembedded/meta-oe \
  ${BSPDIR}/meta-openembedded/meta-multimedia \
  ${BSPDIR}/meta-openembedded/meta-webserver \
  ${BSPDIR}/meta-openembedded/meta-dominion \
  ${BSPDIR}/meta-openembedded/meta-python \
  ${BSPDIR}/meta-openembedded/meta-networking \
  ${BSPDIR}/meta-openembedded/meta-filesystems \
  \
  ${BSPDIR}/meta-wbd \
  \
  ${BSPDIR}/meta-qt5 \
  \
  ${BSPDIR}/meta-mysland \
  \
  ${BSPDIR}/meta-wandboard \
  \
  ${BSPDIR}/meta-olewolf \
  "
```

## conf/layer.conf
```bitbake
# We might have a conf and classes directory, append to BBPATH
BBPATH .= ":${LAYERDIR}"

BBFILES += "${LAYERDIR}/recipes-*/*/*.bb ${LAYERDIR}/recipes-*/*/*.bbappend"

BBFILE_COLLECTIONS += "meta-mysland"
BBFILE_PATTERN_meta-mysland := "^${LAYERDIR}/"

BBFILE_PRIORITY_meta-mysland = "100"

LAYERSERIES_COMPAT_meta-mysland = "rocko"
```

## conf/local.conf
```bitbake
MACHINE = "beaglebone"
DISTRO = "poky"

# i686 or x86_64
SDKMACHINE = "x86_64"

PACKAGE_CLASSES = "package_ipk"

EXTRA_IMAGE_FEATURES = "debug-tweaks"

# mask for non-mender builds
BBMASK = "meta-bbb/recipes-mender"

LICENSE_FLAGS_WHITELIST = "commercial"

DISTRO_FEATURES_append = " \
    ext2 usbhost \
    bluetooth \
    bluez5 \
    wifi \
    nfs \
    ssh-openssh-server \
    pam \
    ${DISTRO_FEATURES_LIBC} \
    "

DISTRO_FEATURES_remove = "wayland x11"

USER_CLASSES = "buildstats image-mklibs image-prelink"

PACKAGECONFIG_append_pn-qemu-native = " sdl"
PACKAGECONFIG_append_pn-nativesdk-qemu = " sdl"

# remove pulseaudio since it brings in x11
DISTRO_FEATURES_BACKFILL_CONSIDERED += "pulseaudio opengl"

PREFERRED_PROVIDER_jpeg = "libjpeg-turbo"

PREFERRED_PROVIDER_udev = "eudev"

# Comment or change to use another kernel version
PREFERRED_VERSION_linux-stable = "4.16.%"

IMAGE_FEATURES_append = " \
	debug-tweaks \
	dev-pkgs \
	tools-debug \
	package-management \
	splash \
	ssh-server-openssh \
	"

# Opkg feed: modify this later!!
PACKAGE_FEED_URIS = "http://192.168.1.100:8000"
PACKAGE_FEED_BASE_PATHS = "ipk"
PACKAGE_FEED_ARCHS = "all cortexa9hf-neon beaglebone"

# Systemd
DISTRO_FEATURES_append = " systemd"
VIRTUAL-RUNTIME_init_manager = "systemd"
DISTRO_FEATURES_BACKFILL_CONSIDERED = "sysvinit"
VIRTUAL-RUNTIME_initscripts = ""

# Hostname
hostname_pn-base-files = "bbb-wifi"

PATCHRESOLVE = "noop"

RM_OLD_IMAGE = "1"

INHERIT += "rm_work"

CONF_VERSION = "1"

############## Extra stuff to install ###################

CORE_PKGS = " \
    gcc g++ binutils libgcc libgcc-dev libstdc++ libstdc++-dev libstdc++-staticdev \
    autoconf automake ccache chkconfig glib-networking glibmm \
    pkgconfig \
    cmake \
    "
IMAGE_INSTALL_append = " \
	opkg \
	opkg-utils \
	bash \
	psplash \
	bluez5 \
	connman \
	connman-conf \
	openssh \
	wpa-supplicant \
	vim \
	lsof \
	ifupdown \
	init-ifupdown \
    fbset-modes \
    fbgrab \
    util-linux-lscpu \
    iproute2-ss \
    iproute2-tc \
    iproute2-lnstat \
    iproute2-ifstat \
    iproute2-genl \
    iproute2-rtacct \
    iproute2-nstat \
    iproute2-ss \
    iproute2-tipc \
    iproute2-rtacct \
    iptables \
    file \
    vim \
    man \
    man-pages \
    sudo \
    binutils \
    strace \
    git \
    packagegroup-core-tools-debug \
    packagegroup-tools-bluetooth \
    packagegroup-core-buildessential \
    customenv \
    wlan-setup \
    ${CORE_PKGS} \
	"
#######################################################

PREFERRED_PROVIDER_virtual/bootloader = "u-boot-denx"
```
